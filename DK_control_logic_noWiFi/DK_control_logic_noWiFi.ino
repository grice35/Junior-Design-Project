#include <pitches.h>

#include <Motor.h>

#include <Wire.h>
#include <Adafruit_GFX.h>
#include <Adafruit_SSD1306.h>

#define SCREEN_WIDTH 128
#define SCREEN_HEIGHT 64
#define OLED_ADDR 0x3C

#define S1      19
#define S2      20
#define S3      21
#define S4      22
#define S5      23

#define BTN1    0 // calibrate
#define BTN2    9 // start
#define BTN3    2 // play sound/flash lights
 
#define LED1    1
#define LED2    8
#define SPKR    3

#define SDA     12
#define SCL     13
#define WIRE Wire

#define M_I1    4
#define M_I2    5
#define M_I3    6
#define M_I4    7

#define USE_MUTEX
SemaphoreHandle_t shared_var_mutex = NULL;

volatile bool ready;

bool button1Event = false;
bool button2Event = false;
bool button3Event = false;
unsigned long lastButton1Interrupt = 0;
unsigned long lastButton2Interrupt = 0;
unsigned long lastButton3Interrupt = 0;

int melody[] = {
  NOTE_D4, NOTE_DS4, NOTE_E4, REST, NOTE_D4, NOTE_D4, NOTE_E4, NOTE_F4, 
  NOTE_C5, NOTE_D5, NOTE_C5, NOTE_D5, NOTE_C5, NOTE_AS4, NOTE_A4, NOTE_G4, NOTE_F4,
  REST, NOTE_C4,
  NOTE_D4, NOTE_DS4, NOTE_E4, REST, NOTE_D4, NOTE_D4, NOTE_E4, NOTE_F4,
  NOTE_C5, NOTE_F5, NOTE_D5, NOTE_AS4, NOTE_A4, NOTE_G4, NOTE_F4,
  REST, NOTE_C4, NOTE_CS4,
  NOTE_D4, NOTE_DS4, NOTE_E4, REST, NOTE_D4, NOTE_D4, NOTE_E4, NOTE_F4,
  NOTE_C5, NOTE_D5, NOTE_C5, NOTE_D5, NOTE_C5, NOTE_AS4, NOTE_A4, NOTE_G4, NOTE_F4,
  NOTE_C5, NOTE_F5, NOTE_D5, NOTE_C5, NOTE_AS4, NOTE_A4, NOTE_AS4, NOTE_B4, NOTE_C5, NOTE_D5,
  NOTE_A4, NOTE_F4, NOTE_D4, NOTE_E4, REST, NOTE_F4,
  REST
};

int durations[] = {
  4, 4, 4, 8, 4, 4, 8, 4, 
  4, 4, 4, 4, 4, 8, 8, 8, 4,
  16, 4,
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  4, 4, 8, 4, 16, 4,
  2
};

Adafruit_SSD1306 display(SCREEN_WIDTH, SCREEN_HEIGHT, &Wire, -1); // OLED screen object

const uint8_t mushroom[] = {
  0xff, 0xff, 0xff, 0xff, 0xff, 0xff, 0xff, 0xff, 0xff, 0xff, 0xff, 0xff, 0xff, 0xff, 0xff, 0xff, 
	0xff, 0xff, 0xff, 0xff, 0xff, 0xff, 0xff, 0xe0, 0x03, 0xff, 0xff, 0xff, 0xff, 0xff, 0xff, 0xff, 
	0xff, 0xff, 0xff, 0xff, 0xff, 0xff, 0xfe, 0x00, 0x00, 0x1f, 0xff, 0xff, 0xff, 0xff, 0xff, 0xff, 
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	0xff, 0xff, 0xff, 0xff, 0xff, 0xff, 0xff, 0xff, 0xff, 0xff, 0xff, 0xff, 0xff, 0xff, 0xff, 0xff
};

const uint8_t star[] = {
  0xff, 0xff, 0xff, 0xff, 0xff, 0xff, 0xff, 0xff, 0xff, 0xff, 0xff, 0xff, 0xff, 0xff, 0xff, 0xff, 
	0xff, 0xff, 0xff, 0xff, 0xff, 0xff, 0xff, 0xff, 0xff, 0xff, 0xff, 0xff, 0xff, 0xff, 0xff, 0xff, 
	0xff, 0xff, 0xff, 0xff, 0xff, 0xff, 0xff, 0xff, 0xff, 0xff, 0xff, 0xff, 0xff, 0xff, 0xff, 0xff, 
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	0xff, 0xff, 0xff, 0xff, 0xff, 0xff, 0xff, 0xff, 0xff, 0xff, 0xff, 0xff, 0xff, 0xff, 0xff, 0xff
};

const uint8_t bullet_bill[] = {
  0xff, 0xff, 0xff, 0xff, 0xff, 0xff, 0xff, 0xff, 0xff, 0xff, 0xff, 0xff, 0xff, 0xff, 0xff, 0xff, 
	0xff, 0xff, 0xff, 0xff, 0xff, 0xff, 0xff, 0xff, 0xff, 0xff, 0xff, 0xff, 0xff, 0xff, 0xff, 0xff, 
	0xff, 0xff, 0xff, 0xff, 0xff, 0xff, 0xff, 0xff, 0xff, 0xff, 0xff, 0xff, 0xff, 0xff, 0xff, 0xff, 
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	0xff, 0xff, 0xff, 0xff, 0xff, 0xff, 0xff, 0xff, 0xff, 0xff, 0xff, 0xff, 0xff, 0xff, 0xff, 0xff
};

const int DK_image_data_width = 128;
const int DK_image_data_height = 64;
const int DK_image_data_size = 1024;

const uint8_t* const items[] = { mushroom, star, bullet_bill };
int sprite = 0;

Motor motorL(M_I1, M_I2, 0, 5000, 8); // left motor
Motor motorR(M_I3, M_I4, 2, 5000, 8); // right motor

const bool ACTIVE_LOW = true;   // set false if your board is active HIGH
const bool SLOW_SPEED = 170;
const int BASE_SPEED = 190;
const int SLIGHT_TURN_SPEED = 200;
const int TURN_SPEED = 190;

void TaskSpeaker(void *pvParameters);
void TaskDisplay(void *pvParameters);
TaskHandle_t speaker_handle;
TaskHandle_t display_handle;

typedef enum {LEFT, RIGHT, STRAIGHT} Turn;
Turn turn;

volatile uint8_t lastMask = 255;         // impossible initial value so it prints first read

void IRAM_ATTR isr1() {
  unsigned long now = micros();
  if (now - lastButton1Interrupt > 400000) { 
    button1Event = true;
    lastButton1Interrupt = now;
  }
}

void IRAM_ATTR isr2() {
  unsigned long now = micros();
  if (now - lastButton2Interrupt > 400000) { 
    button2Event = true;
    lastButton2Interrupt = now;
  }
}

void IRAM_ATTR isr3() {
  unsigned long now = micros();
  if (now - lastButton3Interrupt > 400000) { 
    button3Event = true;
    lastButton3Interrupt = now;
  }
}

uint8_t readMask() {
  uint8_t mask = 0;
  for (int i = 0; i < 5; i++) {
    int raw = digitalRead(S1 + i);                 // 0/1
    int detected = ACTIVE_LOW ? (raw == LOW) : (raw == HIGH); // 0/1
    if (detected) mask |= (1 << (4 - i));                    // bit i + 4 = sensor i
  }
  return mask;
}

void lineFollow(uint8_t mask) {
  // Robot drives forward, stabilizes itself on the line or makes turns based on value of sensor bitmask.
  switch(mask) {
    // Perfect center - go straight
    case 0b00100:  // Only center sensor
      motorL.setMotorSpeed(BASE_SPEED);
      motorR.setMotorSpeed(-BASE_SPEED);
      motorL.startMotor();
      motorR.startMotor();
      turn = STRAIGHT;
      Serial.println("Straight");
      break;
    
    // Slight right deviation - correct left
    case 0b01100:  // Center + left sensor
    case 0b01000:  // Left-center sensor only
      motorL.setMotorSpeed(SLOW_SPEED);
      motorR.setMotorSpeed(-SLIGHT_TURN_SPEED);
      motorL.startMotor();
      motorR.startMotor();
      turn = LEFT;
      Serial.println("Slight left turn");
      break;

    // Slight left deviation - correct right
    case 0b00110:  // Center + right sensor
    case 0b00010:  // Right-center sensor only
      motorL.setMotorSpeed(SLIGHT_TURN_SPEED);
      motorR.setMotorSpeed(-SLOW_SPEED);
      motorL.startMotor();
      motorR.startMotor();
      turn = RIGHT;
      Serial.println("Slight right turn");
      break;

    // Hard left - sharp left turn
    case 0b11000:  // Far left sensors
    case 0b10000:  // Leftmost sensor only
      motorL.setMotorSpeed(-TURN_SPEED);
      motorR.setMotorSpeed(-TURN_SPEED);  // Reverse for pivot turn
      motorL.startMotor();
      motorR.startMotor();
      turn = LEFT;
      Serial.println("hard left");
      break;

    // Hard right - sharp right turn
    case 0b00011:  // Far right sensors
    case 0b00001:  // Rightmost sensor only
      motorL.setMotorSpeed(TURN_SPEED);
      motorR.setMotorSpeed(TURN_SPEED);  // Reverse for pivot turn
      motorL.startMotor();
      motorR.startMotor();
      turn = RIGHT;
      Serial.println("hard right");
      break;

      // All black (intersection or lost line)
    case 0b11111:
      // Could be intersection - continue straight slowly
      motorL.setMotorSpeed(SLOW_SPEED);
      motorR.setMotorSpeed(-SLOW_SPEED);
      motorL.startMotor();
      motorR.startMotor();
      turn = STRAIGHT;
      Serial.println("slow");
      break;

    // All white (lost line completely)
    case 0b00000:
      // Stop and search or continue last direction
      if (turn == LEFT) {
        motorL.setMotorSpeed(SLOW_SPEED);
        motorR.setMotorSpeed(-100);
      } else if (turn == RIGHT) {
        motorL.setMotorSpeed(100);
        motorR.setMotorSpeed(-SLOW_SPEED);
      } else {
        motorL.setMotorSpeed(SLOW_SPEED);
        motorR.setMotorSpeed(-SLOW_SPEED);
      }
      motorL.startMotor();
      motorR.startMotor();
      Serial.println("stop");
      break;

    // Default case for other patterns
    default:
      //motorL.setMotorSpeed(BASE_SPEED);
      //motorR.setMotorSpeed(-BASE_SPEED);
      motorL.setMotorSpeed(BASE_SPEED - 20);
      motorR.setMotorSpeed(-BASE_SPEED + 20);
      turn = STRAIGHT;
      Serial.println("default");
      break;
  }
}

void countdownSequence() {
  // Plays the Mario Kart countdown sequence from the speaker and flashes headlight LEDs.
  
  for (int i = 3; i >= 1; i--) {
    tone(SPKR, NOTE_C6, 500);
    display.clearDisplay();
    display.setTextSize(2);
    display.setTextColor(SSD1306_WHITE);
    display.setCursor(54, 28);
    display.println(i);
    display.display();
    digitalWrite(LED1, HIGH);
    digitalWrite(LED2, HIGH);
    delay(500);
    noTone(SPKR);
    digitalWrite(LED1, LOW);
    digitalWrite(LED2, LOW);
    delay(500);
  }

  tone(SPKR, NOTE_E6, 750);
  display.clearDisplay();
  display.setTextSize(2);
  display.setTextColor(SSD1306_WHITE);
  display.setCursor(58, 28);
  display.println(F("Go!"));
  display.display();
  digitalWrite(LED1, HIGH);
  digitalWrite(LED2, HIGH);
  delay(750);
  noTone(SPKR);
  digitalWrite(LED1, LOW);
  digitalWrite(LED2, LOW);
  delay(500);
  drawLogo();
}

void drawLogo() {
  display.clearDisplay();
  display.display();

  display.drawBitmap(
    (display.width()  -  DK_image_data_width) / 2,
    (display.height() - DK_image_data_height) / 2,
    items[sprite], DK_image_data_width, DK_image_data_height, 1);
  sprite = (sprite + 1) % 3;
  display.display();
}

void setup() {
  Serial.begin(115200);
  
  pinMode(BTN1, INPUT_PULLUP);
  attachInterrupt(BTN1, isr1, RISING);

  pinMode(BTN2, INPUT_PULLUP);
  attachInterrupt(BTN2, isr2, RISING);

  pinMode(BTN3, INPUT_PULLUP);
  attachInterrupt(BTN3, isr3, RISING);

  pinMode(LED1, OUTPUT);
  pinMode(LED2, OUTPUT);

  for (int i = 0; i < 5; i++) {
    pinMode(S1 + i, INPUT);
  }

  Serial.println("Line follower initialized");
  delay(500);  // Wait before starting

  Wire.begin(SDA, SCL);
  if (!display.begin(SSD1306_SWITCHCAPVCC, OLED_ADDR)) {
    Serial.println(F("SSD1306 allocation failed"));
    for (;;);
  }

  ready = false;

  drawLogo();

  shared_var_mutex = xSemaphoreCreateMutex();
  xTaskCreate(TaskSpeaker, "Speaker Task", 2048, NULL, 20, &speaker_handle);
  xTaskCreate(TaskDisplay, "Display Task", 2048, NULL, 21, &display_handle);

  tone(SPKR, 1000, 5);

  delay(600);

}

void loop() {
  
  uint8_t mask = readMask();

  if (mask != lastMask) {
    lastMask = mask;
    Serial.print("Sensor mask: ");
    for (int i = 4; i >= 0; i--) {  // Print left to right
      Serial.print((mask >> i) & 1);
    }
    Serial.println();
  }

  if (!digitalRead(BTN1)) {
    Serial.println("Start");
    countdownSequence();
    digitalWrite(LED1, LOW);
    digitalWrite(LED2, LOW);
    motorL.setMotorSpeed(TURN_SPEED);
    motorR.setMotorSpeed(-TURN_SPEED);
    motorL.startMotor();
    motorR.startMotor();
    if (xSemaphoreTake(shared_var_mutex, portMAX_DELAY) == pdTRUE) {
      ready = true;
      xSemaphoreGive(shared_var_mutex);
    }
  }

  if (!digitalRead(BTN2)) {
    Serial.println("Stop");
    if (xSemaphoreTake(shared_var_mutex, portMAX_DELAY) == pdTRUE) {
      ready = false;
      xSemaphoreGive(shared_var_mutex);
    }
  }

  if (ready) {
    lineFollow(mask);
  } else {
    //Serial.println("Stop");
    motorL.setMotorSpeed(0);
    motorR.setMotorSpeed(0);
  }

}

void TaskSpeaker(void *pvParameters) {
  pinMode(SPKR, OUTPUT);

  for (;;) {
#ifdef USE_MUTEX
    if (shared_var_mutex != NULL) {
      if (xSemaphoreTake(shared_var_mutex, portMAX_DELAY) == pdTRUE) {
        bool start = ready;
        xSemaphoreGive(shared_var_mutex);
#endif
        if (start) {
          int size = sizeof(durations) / sizeof(int);
          for (int note = 0; note < size; note++) {
            int duration = 1000 / durations[note];
            tone(SPKR, melody[note], duration);
            int pauseBetweenNotes = duration * 1;
            delay(pauseBetweenNotes);

            noTone(SPKR);
          } 
        }
#ifdef USE_MUTEX 
      }
    }
#endif
    vTaskDelay(5 / portTICK_PERIOD_MS);
  }        
}

void TaskDisplay(void *pvParameters) {
  for (;;) {
#ifdef USE_MUTEX
    if (shared_var_mutex != NULL) {
      if (xSemaphoreTake(shared_var_mutex, portMAX_DELAY) == pdTRUE) {
        bool start = ready;
        xSemaphoreGive(shared_var_mutex);
#endif
        if (start) {
          display.clearDisplay();
          display.display();

          display.drawBitmap(
            (display.width()  -  DK_image_data_width) / 2,
            (display.height() - DK_image_data_height) / 2,
            items[sprite], DK_image_data_width, DK_image_data_height, 1);
          sprite = (sprite + 1) % 3;
          display.display();
          vTaskDelay(100 / portTICK_PERIOD_MS);
        }
#ifdef USE_MUTEX 
      }
    }
#endif
    vTaskDelay(5 / portTICK_PERIOD_MS);
  }        
}